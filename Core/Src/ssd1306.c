#include "ssd1306.h"
#include <string.h>

static const uint8_t font6x8[95][6] = {
    {0x00, 0x00, 0x00, 0x00, 0x00, 0x00}, // space
    {0x00, 0x00, 0x4f, 0x00, 0x00, 0x00}, // !
    {0x00, 0x07, 0x00, 0x07, 0x00, 0x00}, // "
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    {0x02, 0x01, 0x02, 0x04, 0x02, 0x00}, // ~
};

static ssd1306_status_t write_cmd(ssd1306_dev_t *dev, uint8_t cmd) {
    if (HAL_I2C_Mem_Write(dev->hi2c, SSD1306_ADDR, 0x00, 1, &cmd, 1, 100) != HAL_OK) {
        return SSD1306_ERR_I2C;
    }
    return SSD1306_OK;
}

ssd1306_status_t ssd1306_init(ssd1306_dev_t *dev, I2C_HandleTypeDef *hi2c) {
    dev->hi2c = hi2c;

    const uint8_t init_cmds[] = {
        0xAE,       // Display OFF
        0xA8, 0x3F, // MUX Ratio 63
        0xD3, 0x00, // Display offset 0
        0x40,       // Start line 0
        0xA1,       // Segment remap
        0xC8,       // COM scan direction
        0xDA, 0x12, // COM pins config
        0x81, 0x7F, // Contrast
        0xA4,       // Entire display ON, follow RAM
        0xA6,       // Normal display
        0xD5, 0x80, // Clock divide ratio
        0x8D, 0x14, // Enable charge pump
        0x20, 0x00, // Memory addressing mode horizontal
        0x21, 0x00, 0x7F, // Column address 0-127
        0x22, 0x00, 0x07, // Page address 0-7
        0xAF        // Display ON
    };

    for (int i = 0; i < sizeof(init_cmds); i++) {
        if (write_cmd(dev, init_cmds[i]) != SSD1306_OK) {
            return SSD1306_ERR_I2C;
        }
    }

    ssd1306_clear(dev);
    return ssd1306_flush(dev);
}

void ssd1306_clear(ssd1306_dev_t *dev) {
    memset(dev->buf, 0, SSD1306_BUF_SIZE);
}

void ssd1306_pixel(ssd1306_dev_t *dev, uint8_t x, uint8_t y, bool on) {
    if (x >= SSD1306_WIDTH || y >= SSD1306_HEIGHT) return;
    
    uint16_t idx = x + (y / 8) * SSD1306_WIDTH;
    if (on) {
        dev->buf[idx] |= (1 << (y % 8));
    } else {
        dev->buf[idx] &= ~(1 << (y % 8));
    }
}

void ssd1306_putchar(ssd1306_dev_t *dev, uint8_t x, uint8_t y, char c) {
    if (c < ' ' || c > '~') c = ' ';
    uint8_t font_idx = c - ' ';
    
    for (uint8_t col = 0; col < 6; col++) {
        uint8_t line = font6x8[font_idx][col];
        for (uint8_t row = 0; row < 8; row++) {
            ssd1306_pixel(dev, x + col, y + row, (line & (1 << row)) != 0);
        }
    }
}

void ssd1306_puts(ssd1306_dev_t *dev, uint8_t x, uint8_t y, const char *s) {
    while (*s) {
        ssd1306_putchar(dev, x, y, *s);
        x += 6;
        if (x + 6 > SSD1306_WIDTH) {
            x = 0;
            y += 8;
        }
        s++;
    }
}

ssd1306_status_t ssd1306_flush(ssd1306_dev_t *dev) {
    // Set column address
    write_cmd(dev, 0x21);
    write_cmd(dev, 0x00);
    write_cmd(dev, 0x7F);
    
    // Set page address
    write_cmd(dev, 0x22);
    write_cmd(dev, 0x00);
    write_cmd(dev, 0x07);

    /* 1024 bytes @ 100 kHz takes ~93 ms; allow 250 ms timeout for clock stretching and RTOS preemption */
    if (HAL_I2C_Mem_Write(dev->hi2c, SSD1306_ADDR, 0x40, 1, dev->buf, SSD1306_BUF_SIZE, 250) != HAL_OK) {
        return SSD1306_ERR_I2C;
    }
    
    return SSD1306_OK;
}
